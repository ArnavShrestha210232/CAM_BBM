## apps/examples/SPI/Kconfig
```kconfig
#
# For a description of the syntax of this configuration file,
# see the file kconfig-language.txt in the NuttX tools repository.
#

config EXAMPLES_SPI
	tristate "\"SPI, World!\" example"
	default n
	---help---
		Enable the \"SPI, World!\" example

if EXAMPLES_SPI

config EXAMPLES_SPI_PROGNAME
	string "Program name"
	default "SPI"
	---help---
		This is the name of the program that will be used when the NSH ELF
		program is installed.

config EXAMPLES_SPI_PRIORITY
	int "SPI task priority"
	default 100

config EXAMPLES_SPI_STACKSIZE
	int "SPI stack size"
	default DEFAULT_TASK_STACKSIZE

endif
```

## apps/examples/basic/Kconfig
```kconfig
#
# For a description of the syntax of this configuration file,
# see the file kconfig-language.txt in the NuttX tools repository.
#

config EXAMPLES_BASIC
	tristate "\"Basic, World!\" example"
	default n
	---help---
		Enable the \"Basic, World!\" example

if EXAMPLES_BASIC

config EXAMPLES_BASIC_PROGNAME
	string "Program name"
	default "basic"
	---help---
		This is the name of the program that will be used when the NSH ELF
		program is installed.

config EXAMPLES_BASIC_PRIORITY
	int "basic task priority"
	default 100

config EXAMPLES_BASIC_STACKSIZE
	int "Basic stack size"
	default DEFAULT_TASK_STACKSIZE

endif
```

## apps/examples/camera_MSN2/Kconfig
```kconfig
#
# For a description of the syntax of this configuration file,
# see the file kconfig-language.txt in the NuttX tools repository.
#

config EXAMPLES_CAMERA_MSN2
	tristate "\camera mission MSN2 example"
	default n
	---help---
		Enable the \"Camera MSN2\" example

if EXAMPLES_CAMERA_MSN2

config EXAMPLES_CAMERA_MSN2_PROGNAME
	string "Program name"
	default "camera_MSN2"
	---help---
		This is the name of the program that will be used when the NSH ELF
		program is installed.

config EXAMPLES_CAMERA_MSN2_PRIORITY
	int "Camera MSN2 task priority"
	default 100

config EXAMPLES_CAMERA_MSN2_STACKSIZE
	int "Camera MSN2 stack size"
	default DEFAULT_TASK_STACKSIZE

endif
```
